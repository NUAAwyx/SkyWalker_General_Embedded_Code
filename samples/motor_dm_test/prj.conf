## CMakeLists.txt
```
cmake_minimum_required(VERSION 3.20.0)

find_package(Zephyr REQUIRED HINTS $ENV{ZEPHYR_BASE})
project(motor_dm_test)

target_sources(app PRIVATE src/main.c)
```

## prj.conf
```kconfig
CONFIG_SKYWALKER_DRIVER_MOTOR=y
CONFIG_SKYWALKER_DRIVER_MOTOR_DM=y
CONFIG_CAN=y
CONFIG_FPU=y
CONFIG_FPU_SHARING=y
```

## boards/dm_mc02.overlay
```dts
/*
 * motor_dm_test 台架 overlay：1 台达妙电机（MIT 模式，纯力矩）。
 *
 * 台架的唯一目的：让 DT_INST_FOREACH_STATUS_OKAY(MOTOR_DM_INST) 展开成非零，
 * 使 motor_dm.c 首次真正进入二进制。多台 DM 的正式配置留给 application/。
 * 节点名与属性名一律以 skywalker,motor_dm.yaml 为准。
 */

/ {
	dm_motor: dm_motor {
		compatible = "skywalker,motor_dm";

		/* ⚠️ MIT 模式下仲裁 ID 就是电机自己的 CAN ID，**没有偏移**。
		 *    这里 id 和 tx-id 必须写成同一个值。
		 *    抄 DJI 的 0x200 会让电机一个字节都收不到，而且不报错——
		 *    总线上只看到帧一直发，电机毫无反应。 */
		can-dev = <&can1>;
		id      = <1>;      /* 电机 CAN_ID，须与调试助手里设的一致 */
		tx-id   = <0x01>;   /* 必须 == id */
		rx-id   = <0x00>;   /* 反馈帧 ID = Master ID，手册 4.1，默认 0。
		                     * 所有 DM 共用这一个 ID，靠 D[0] 低 4 位认领。 */
		type    = "DM_TYPE_MIT";

		/* 电机里用调试助手设的 PMAX/VMAX/TMAX 必须与
		 * motor_dm.c 的 MOTOR_DM_P_MAX / V_MAX / T_MAX 一致（手册 4.2）。
		 * 对不上不报错，只是扭矩差一个固定系数。 */
		status  = "okay";
	};
};
```

## src/main.c
```c
#include "drivers/motors/motor_dm/motor_dm.h"

#include <zephyr/drivers/can.h>


const struct device *motor = DEVICE_DT_GET(DT_NODELABEL(dm_motor));

/* 台架初值：力矩 0。开机就让它转起来是没有意义的——第一阶段要验的是
 * 「使能握手能不能自愈」和「反馈帧解得对不对」，不是控制性能。
 * 想让轮子动，把这个数改成几 N·m（先离地、先给小的）。 */
static motor_setpoint desired = {
    .torque = 0.0f,
    .mode = MOTOR_MODE_TORQUE,
};

void motor_control_calculate_thread_entry(void *arg1, void *arg2, void *arg3);
void motor_can_send_thread_entry(void *arg1, void *arg2, void *arg3);

void motor_control_calculate_timer_callback(struct k_timer *timer_id);
void motor_can_send_timer_callback(struct k_timer *timer_id);


K_THREAD_DEFINE(motor_control_calculate_thread, 2048, motor_control_calculate_thread_entry, NULL, NULL, NULL, 2, 0, 0);
K_THREAD_DEFINE(motor_can_send_thread, 2048, motor_can_send_thread_entry, NULL, NULL, NULL, 1, 0, 0);

K_TIMER_DEFINE(motor_control_calculate_timer, motor_control_calculate_timer_callback, NULL);
K_TIMER_DEFINE(motor_can_send_timer, motor_can_send_timer_callback, NULL);

K_SEM_DEFINE(motor_control_calculate_sem, 0, 1);
K_SEM_DEFINE(motor_can_send_sem, 0, 1);

void motor_control_calculate_timer_callback(struct k_timer *timer_id){
    k_sem_give(&motor_control_calculate_sem);
}

void motor_can_send_timer_callback(struct k_timer *timer_id){
    k_sem_give(&motor_can_send_sem);
}

void motor_control_calculate_thread_entry(void *arg1, void *arg2, void *arg3){

    motor_data now_data;
    uint32_t tick = 0;

    while (1)
    {
        /* 循环第一行 = 这一拍的入口：timer 每 1ms give 一次，这里 take 一次，
         * 循环体的节奏就锁在 1kHz。放到循环外就只认第一次节拍。 */
        k_sem_take(&motor_control_calculate_sem, K_FOREVER);

        motor_get(motor, &now_data);
        motor_set(motor, &desired);

        /* 每 500 拍（0.5s）打一行。串口是唯一的仪表：
         *   enabled=0 一直不动 → 使能帧没到电机（接线 / id / tx-id）
         *   enabled=1            → 握手成功，之后 torque 才是可信的
         * 有钳形表或 CAN 分析仪时这行可以删。 */
        if (++tick % 500U == 0U) {
            printk("en=%d pos=%d mrad vel=%d mrad/s cur=%d mNm t=%d C\n",
                   (int)now_data.enabled,
                   (int)(now_data.angle * 1000.0f),
                   (int)(now_data.omega * 1000.0f),
                   (int)(now_data.torque * 1000.0f),
                   (int)now_data.temperature);
        }
    }
}

void motor_can_send_thread_entry(void *arg1, void *arg2, void *arg3){

    const motor_config *cfg = (const motor_config *)motor->config;

    struct can_frame frame = {
        .id = cfg->tx_id,
        .dlc = 8,
    };

    while (1)
    {
        /* can_pack 打的是当下的目标（未使能时是使能帧），必须在循环内重做，
         * 否则帧内容永远停在开机那一刻 */
        k_sem_take(&motor_can_send_sem, K_FOREVER);
        motor_can_pack(motor, frame.data);
        can_send(cfg->can_dev, &frame, K_MSEC(1), NULL, NULL);
    }
}

int main(){
    const motor_config *cfg = (const motor_config *)motor->config;

    k_timer_start(&motor_control_calculate_timer, K_NO_WAIT, K_MSEC(1));
    k_timer_start(&motor_can_send_timer, K_NO_WAIT, K_MSEC(1));

    can_start(cfg->can_dev);

    return 0;
}
```
