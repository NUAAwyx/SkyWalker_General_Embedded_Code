## CMakeLists.txt
```
cmake_minimum_required(VERSION 3.20.0)

find_package(Zephyr REQUIRED HINTS $ENV{ZEPHYR_BASE})
project(motor_dji_test)

target_sources(app PRIVATE src/main.c)
```

## prj.conf
```kconfig
CONFIG_SKYWALKER_DRIVER_MOTOR=y
CONFIG_SKYWALKER_DRIVER_MOTOR_DJI=y
CONFIG_SKYWALKER_DRIVER_PID=y
CONFIG_SKYWALKER_LIB_DR16=y
CONFIG_CAN=y
CONFIG_FPU=y
CONFIG_FPU_SHARING=y
CONFIG_UART_ASYNC_API=y
CONFIG_NOCACHE_MEMORY=y
```

## boards/dm_mc02.overlay
```dts
/*
 * motor_dji_test 台架 overlay：1 台 M3508 + 一个速度环 PID。
 *
 * 台架的唯一目的：让 DT_INST_FOREACH_STATUS_OKAY(MOTOR_DJI_INST) 展开成非零，
 * 使 motor_dji.c 首次真正进入二进制。4 台电机的正式配置留给 application/。
 * 节点名与属性名一律以 skywalker,motor_dji.yaml / skywalker,pid.yaml 为准。
 */

/ {
	speed_pid: speed_pid {
		compatible = "skywalker,pid";
		/* TODO(hw): 增益沿用 mambo 的 M3508 速度环起点，未在本车整定。
		 * out-max 的量纲也待确认（mambo 输出是归一化量，本驱动的输出口径
		 * 取决于发送线程怎么填帧）——上电后按阶跃响应重调。 */
		k-p      = "8";
		k-i      = "0";
		k-d      = "0";
		i-max    = "2";
		out-max  = "2";
		deadband = "0";
	};

	m3508_motor: m3508_motor {
		compatible = "skywalker,motor_dji";

		/* 1 台就用 ID1：DJI 的对应关系是 0x201 ↔ ID1，tx 帧 0x200 载 ID1~4 */
		can-dev    = <&can1>;
		id         = <1>;
		tx-id      = <0x200>;
		rx-id      = <0x201>;
		type       = "M3508";
		gear-ratio = "19.2032";
		status     = "okay";
	};
};
```

## src/main.c
```c
#include "drivers/motors/motor_dji/motor_dji.h"
#include "drivers/pid/pid.h"
#include <zephyr/drivers/can.h>

#include "lib/dr16/dr16.h"


const struct device *motor = DEVICE_DT_GET(DT_NODELABEL(m3508_motor));
const struct device *pid = DEVICE_DT_GET(DT_NODELABEL(speed_pid));

static motor_setpoint desired = {
    .omega = 2.0f,
    .mode = MOTOR_MODE_SPEED,
};

void motor_control_calculate_thread_entry(void *arg1, void *arg2, void *arg3);
void motor_can_send_thread_entry(void *arg1, void *arg2, void *arg3);

void motor_control_calculate_timer_callback(struct k_timer *timer_id);
void motor_can_send_timer_callback(struct k_timer *timer_id);


K_THREAD_DEFINE(motor_control_calculate_thread, 2048, motor_control_calculate_thread_entry, NULL, NULL, NULL, 2, 0, 0);
K_THREAD_DEFINE(motor_can_send_thread, 2048, motor_can_send_thread_entry, NULL, NULL, NULL, 1, 0, 0);

K_TIMER_DEFINE(motor_control_calculate_timer, motor_control_calculate_timer_callback, NULL);
K_TIMER_DEFINE(motor_can_send_timer, motor_can_send_timer_callback, NULL);

K_SEM_DEFINE(motor_control_calculate_sem, 0, 1);
K_SEM_DEFINE(motor_can_send_sem, 0, 1);

void motor_control_calculate_timer_callback(struct k_timer *timer_id){
    k_sem_give(&motor_control_calculate_sem);
}

void motor_can_send_timer_callback(struct k_timer *timer_id){
    k_sem_give(&motor_can_send_sem);
}

void motor_control_calculate_thread_entry(void *arg1, void *arg2, void *arg3){

    motor_data now_data;
    motor_setpoint target;

    pid_data *pid_state = pid->data;
    const pid_config *pid_cfg = pid->config;

    float target_value;
    float now;

    while (1)
    {
        /* 循环第一行 = 这一拍的入口：timer 每 1ms give 一次，这里 take 一次，
         * 循环体的节奏就锁在 1kHz。放到循环外就只认第一次节拍。 */
        k_sem_take(&motor_control_calculate_sem, K_FOREVER);

        switch (desired.mode)
        {
        case MOTOR_MODE_POSITION:
            target_value = desired.angle;
            break;

        case MOTOR_MODE_SPEED:
            target_value = desired.omega;
            break;

        case MOTOR_MODE_TORQUE:
            target_value = desired.torque;
            break;

        default:
            break;
        }

        /* 取反馈 -> 算 PID -> 写目标，三件事每拍都要重做一遍 */
        motor_get(motor, &now_data);
        now = now_data.omega;
        pid_update(pid_state, pid_cfg, target_value, now, 0.001f, 0.0f);

        target = (motor_setpoint){
            .torque = pid_state->output,
            .mode = MOTOR_MODE_TORQUE,
        };

        motor_set(motor, &target);
    }
}

void motor_can_send_thread_entry(void *arg1, void *arg2, void *arg3){

    const motor_config *cfg = (const motor_config *)motor->config;

    struct can_frame frame = {
        .id = cfg->tx_id,
        .dlc = 8,
    };

    while (1)
    {
        /* can_pack 打的是当下的 target.torque，必须在循环内重做，
         * 否则帧内容永远停在开机那一刻 */
        k_sem_take(&motor_can_send_sem, K_FOREVER);
        motor_can_pack(motor, frame.data);
        can_send(cfg->can_dev, &frame, K_MSEC(1), NULL, NULL);
    }
}

int main(){
    const motor_config *cfg = (const motor_config *)motor->config;

    dr16_init(DEVICE_DT_GET(DT_NODELABEL(uart5)));

    k_timer_start(&motor_control_calculate_timer, K_NO_WAIT, K_MSEC(1));
    k_timer_start(&motor_can_send_timer, K_NO_WAIT, K_MSEC(1));

    can_start(cfg->can_dev);

    return 0;
}
```
