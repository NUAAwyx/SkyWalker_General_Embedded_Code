## drivers/Kconfig
```kconfig
menu "Skywalker Device Drivers"

config SKYWALKER_DRIVER_PID
    bool "Skywalker PID Controller"
    help
        Enable the PID Controller driver.

config SKYWALKER_DRIVER_KALMAN_FILTER
    bool "Skywalker Kalman Filter"
    help
        Enable the Kalman Filter driver.

config SKYWALKER_DRIVER_IMU
      bool "Skywalker IMU Driver"
      select CMSIS_DSP_FASTMATH
      help
          Enable the IMU attitude estimation driver.
          Select estimation method via DT property "estimator". 

config SKYWALKER_DRIVER_MOTOR
    bool "Skywalker Motor Driver Framework"
    depends on CAN
    help
        Common motor driver abstraction layer (base API). Concrete motor
        drivers (DJI, DM, ...) depend on this.

config SKYWALKER_DRIVER_MOTOR_DJI
    bool "Skywalker DJI Motor Driver"
    depends on SKYWALKER_DRIVER_MOTOR
    help
        Enable the DJI CAN motor driver (M3508 / M2006 / GM6020).

config SKYWALKER_DRIVER_MOTOR_DM
    bool "Skywalker DM Motor Driver"
    depends on SKYWALKER_DRIVER_MOTOR
    help
        Enable the DM CAN motor driver.

config SKYWALKER_DRIVER_CHASSIS
    bool "Skywalker Chassis Driver"
    help
        Enable the chassis driver

config SKYWALKER_DRIVER_GIMBAL
    bool "Skywalker Gimbal Driver"
    help
        Enable the gimbal driver

endmenu
```

## dts/bindings/motors/skywalker,motor_dji.yaml
```yaml
description: Skywalker DJI Motor

compatible: "skywalker,motor_dji"

include: [base.yaml]

properties:
  can-dev:
    type: phandle
    required: true
    description: CAN 控制器设备节点
  id:
    type: int
    required: true
    description: 电机 ID
  tx-id:
    type: int
    required: true
    description: CAN 发送报文 ID
  rx-id:
    type: int
    required: true
    description: CAN 接收报文 ID
  type:
    type: string
    required: true
    enum:
      - "M2006"
      - "M3508"
      - "GM6020"
    description: 电机型号
  gear-ratio:
    type: string
    required: true
    description: 电机减速比
  angle-offset-deg:
    type: string
    required: false
    default: "0"
    description: 编码器角度偏移量，单位：度
```

## dts/bindings/motors/skywalker,motor_dm.yaml
```yaml
description: Skywalker DM Motor

compatible: "skywalker,motor_dm"

include: [base.yaml]

properties:
  can-dev:
    type: phandle
    required: true
    description: CAN 控制器设备节点
  id:
    type: int
    required: true
    description: 电机 ID
  tx-id:
    type: int
    required: true
    description: CAN 发送报文 ID
  rx-id:
    type: int
    required: true
    description: CAN 接收报文 ID
  type:
    type: string
    required: true
    enum:
      - "DM_TYPE_MIT"
      - "DM_TYPE_POSITION_AND_SPEED"
      - "DM_TYPE_SPEED_ONLY"
    description: 控制协议
```

## lib/Kconfig
```kconfig
menu "Skywalker Libraries"

config SKYWALKER_LIB_MATRIX
    bool "Matrix"
    select CMSIS_DSP
    select CMSIS_DSP_MATRIX
    help
        Enable the Matrix library for matrix operations.

config SKYWALKER_LIB_MATRIX_STORAGE
    bool "Matrix flash storage"
    depends on SKYWALKER_LIB_MATRIX
    select FILE_SYSTEM
    select ZMS
    select FLASH_PAGE_LAYOUT
    select FLASH_MAP
    help
        Enable flash storage of matrices (matrix_storage_save/read...).
        Requires a flash driver on the board.

config SKYWALKER_LIB_VOFA
    bool "vofa"
    depends on SERIAL
    help
        Enable the VOFA library for debug

config SKYWALKER_LIB_DR16
    bool "dr16"
    depends on SERIAL
    help
        Enable the DR16 library

endmenu
```
